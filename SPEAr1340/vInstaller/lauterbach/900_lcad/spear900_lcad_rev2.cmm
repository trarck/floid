SYStem.RESet
SYStem.CPU CortexA9MPCore
SYStem.JtagClock 10Mhz
SYStem.Option EnReset OFF
;SYStem.CONFIG CoreNumber 2.    ; Define, how many cores are available in that debug session
SYStem.CONFIG MEMORYACCESSPORT 0.
SYStem.CONFIG DEBUGACCESSPORT  1.

;                                    ; core 0   core 1
;SYStem.CONFIG COREBASE              0x80018000 0x8001A000
SYStem.CONFIG COREBASE              0x80018000

SYStem.CONFIG CTIBASE          0x8001C000
SYStem.CONFIG ETMBASE          0x8001E000
SYStem.CONFIG ETBBASE          0x80004000
SYStem.CONFIG TPIUBASE         0x80001000
SYStem.CONFIG CTICONFIG        CORTEXV1

System.config ETMFUNNELPORT     1.
;system.config etmetbfunnelport 0.         0.
SYStem.CONFIG FUNNELBASE       0x80003000
system.config TPIUFUNNELBASE   0x80003000 ; (AV)
system.config ETBFUNNELBASE    0x80006000 ; (AV)
   
;SYStem.Option L2CacheBase      <address>
SYStem.Up


; enable DDR
D.LOAD "..\..\xloader\xloader.img" 0xb38012c0
R.S PC 0xb3801300
go
wait 3s
break

; load u-boot
D.LOAD "..\..\u-boot\u-boot.img" 0x0
R.S PC 0x40
go




















